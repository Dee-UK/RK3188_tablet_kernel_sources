## arch/arm/mach-rk3188/Kconfig
```kconfig
choice
	prompt "Rockchip SoC Type"
	depends on ARCH_RK3188

config SOC_RK3188
	bool "RK3188"
	select USB_ARCH_HAS_EHCI if USB_SUPPORT

config SOC_RK3188M
	bool "RK3188M"
	select USB_ARCH_HAS_EHCI if USB_SUPPORT

endchoice

choice
	prompt "RK3188 Board Type"
	depends on SOC_RK3188

config PIPO_M6PRO
	bool "Pipo M6Pro"

config PIPO_M6MAX
	bool "Pipo M6Max"

config PIPO_M7PRO
	bool "Pipo M7Pro"
        
config PIPO_M8HD
        bool "Pipo M8HD"
        
config PIPO_M8PRO
        bool "Pipo M8Pro"

config PIPO_M9PRO
        bool "Pipo M9Pro"

config PIPO_M9MAX
        bool "Pipo M9MAX"
        
config PIPO_U8
        bool "Pipo U8"

config MACH_RK3188_U30GT2
	bool "Cube U30GT2"

config MACH_RK3188_DS1006H
	bool "RK3188 ds1006h board"

config MACH_RK3188_TB
	bool "RK3188 Top Board"

config MACH_RK3188_SDK
	bool "RK3188 sdk Board"

config MACH_RK3188_FPGA
	bool "RK3188 FPGA board"
	select RK_FPGA

config MACH_RK3188_LR097
        bool "RK3188 LR097 JC21CA board"
        
config MACH_RK3188_FAC
        bool "RK3188 Board for factory"
        select MACH_RK_FAC

endchoice

choice
	prompt "Custom RK3188 frequencies by str0ntium-9o.
	depends on PIPO_M9PRO
        help 
                Provides opportunity to choose maximum frequency for CPU

config M9_PRO_STR_STANDART_FREQ
	bool "Standart RK3188 frequency"
	depends on PIPO_M9PRO
	default y
	help
		Standart RK3188 frequency 1600 MHz

config M9_PRO_STR_CPU_OC
	bool "Enable CPU overclock to 1700 MHz"
	depends on PIPO_M9PRO
	default n
	help
		RK3188 1700 MHz max frequency

config M9_PRO_STR_CPU_ULV
	bool "Enable CPU downclock to 1400 MHz"
	depends on PIPO_M9PRO
	default n
	help
		RK3188 1400 MHz max frequency

endchoice
```

## drivers/input/touchscreen/ct36x/Kconfig
```kconfig
#
#D33 CT36X Driver config
#

menuconfig TOUCHSCREEN_CT36X
	tristate "D33 CT36x Driver"
	help
	  Enable support for the VTL CT363/5 touchscreen driver.


config CT36X_X_REVERSE
	bool "Reverse x-axis?"
	depends on TOUCHSCREEN_CT36X
	default n
	help
		CT36x X axis reverse
config CT36X_Y_REVERSE
	bool "Reverse y-axis?"
	depends on TOUCHSCREEN_CT36X
	default n
	help
		CT36x y axis reverse

config CT36X_XY_SWAP
	bool "Swap x&y axis?"
	depends on TOUCHSCREEN_CT36X
	default n
	help
		CT36x swap X/Y axis

config CT36X_CHIP_UPDATE_SUPPORT
	bool "Enable firmware update of CT36X"
	depends on TOUCHSCREEN_CT36X
	default n
	help
	  Enable Support of flashing new firmware to selected VTL chip.
	  A valid image must be provided.
	
config CHIP_DRIVER_FILE
	string "Firmware Image Blob Name"
	depends on TOUCHSCREEN_CT36X && CT36X_CHIP_UPDATE_SUPPORT
	default "lx62js07_1920x1200_A1_CT363_V01_E087_130711.dat"
	help
	  Filename of the firmware image of the chip.
	
```

## drivers/input/touchscreen/ct36x_ts/Kconfig
```kconfig
#
# Touchscreen driver configuration
#


config CT36X_TS
	tristate "VTL ct36x based touchscreens"
	default y

if CT36X_TS

choice
	prompt "Device driver platform support"
	default CT36X_TS_PLATFORM_GENERIC

	config CT36X_TS_PLATFORM_GENERIC
	  bool "Generic"

	config CT36X_TS_PLATFORM_ROCKCHIP
	  bool "RockChip"

	config CT36X_TS_PLATFORM_ALLWINNER
	  bool "AllWinner"
endchoice

choice
	prompt "Device driver chip support"
	default CT36X_TS_CHIP_CT360

	config CT36X_TS_CHIP_CT360
	  bool "ct360"

	config CT36X_TS_CHIP_CT365
	  bool "ct363/ct365"
endchoice

config CT36X_TS_MISC
	bool "Device driver misc support"
	default y

		config CT36X_TS_MISC_X_REVERSE
		bool "reverse X axis"
		default n
		depends on CT36X_TS_MISC

		config CT36X_TS_MISC_Y_REVERSE
		bool "reverse Y axis"
		default n
		depends on CT36X_TS_MISC

		config CT36X_TS_MISC_XY_SWAP
		bool "swap X, Y"
		default n
		depends on CT36X_TS_MISC

		config CT36X_TS_MISC_NEW_TPS
		bool "uses new touch point structure"
		default y
		depends on CT36X_TS_MISC

		config CT36X_TS_FLASH
		bool "Flash firmware on boot"
		default y
		depends on CT36X_TS_MISC

endif
```

## drivers/input/touchscreen/vtl/Kconfig
```kconfig
#
# modular VTL Tech CT36X Driver
#

menuconfig TOUCHSCREEN_CT36X_IIC
	tristate "Modular VTL Tech CT36x Driver"
	help
	  Enable support for the VTL CT363/5 touchscreen driver.

choice

    depends on TOUCHSCREEN_CT36X_IIC
	prompt  "Touchscreen Chip Selection"

	config CT360_CHIP_VER
		bool "CT360"

	config CT363_CHIP_VER
		bool "CT363/CT365"

endchoice

config TOUCH_MAX_X
                int "touch max x resolution"
                depends on TOUCHSCREEN_CT36X_IIC
                default 1024
                help
                  CT36x touch max X resolution

config TOUCH_MAX_Y
                int "touch max y resolution"
                depends on TOUCHSCREEN_CT36X_IIC
                default 600
                help
                  CT36x touch max X resolution

config X_REVERSE
	bool "Reverse x-axis?"
	depends on TOUCHSCREEN_CT36X_IIC
	default n
	help
		CT36x X axis reverse
config Y_REVERSE
	bool "Reverse y-axis?"
	depends on TOUCHSCREEN_CT36X_IIC
	default n
	help
		CT36x y axis reverse

config XY_SWAP
	bool "Swap x&y axis?"
	depends on TOUCHSCREEN_CT36X_IIC
	default n
	help
		CT36x swap X/Y axis

config CT36X_CHIP_UPDATE_SUPPORT
	bool "Enable firmware update of CT36X"
	depends on TOUCHSCREEN_CT36X_IIC
	default n
	help
	  Enable Support of flashing new firmware to selected VTL chip.
	  A valid image must be provided.
	
config CHIP_DRIVER_FILE
	string "Firmware Image Blob Name"
	depends on TOUCHSCREEN_CT36X_IIC && CT36X_CHIP_UPDATE_SUPPORT
	default "CT360_ODYS_GENIO.DAT"
	help
	  Filename of the firmware image of the chip.
	
```

## drivers/net/wireless/mt5931_kk/Kconfig
```kconfig
config MT5931
	  depends on WLAN_80211 && MMC
	  select WIRELESS_EXT
	  select WEXT_PRIV
	  select CFG80211
          select NL80211_TESTMODE
 	  select MAC80211
	  bool "MediaTek MT5931 USB Support"
	  ---help---
	    MediaTek MT5931 WiFi

	
config MT5931_MT6622
	  depends on MT5931
	  bool "MediaTek MT6622 Bluetooth"
	  ---help---
	    MediaTek MT6622 WiFi Bluetooth support

config MTK_MT5931
	  depends on MT5931
	bool "MediaTeK MT5931 KitKat SDIO Wifi Driver"
```

## fs/fuse-exfat/Kconfig
```kconfig
config FUSE_EXFAT
	tristate "Fuse based exFAT filesystem support"
	depends on FUSE_FS
	help
	  This is a FUSE based exFAT driver.
```
